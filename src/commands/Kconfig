## src/system/Kconfig
```kconfig
#
# For a description of the syntax of this configuration file,
# see the file kconfig-language.txt in the NuttX tools repository.
#
# SPDX-License-Identifier: Apache-2.0
#

config PNUT_SYSTEM
	bool "The system program"
	default n
	depends on PNUT_LIB && NETUTILS_NANOPB
	---help---
		pnut_system, the program of the services every other program waits
		on (RFC 0007).  So far it serves Board's description of the
		device (RFC 0024), Service states (RFC 0006), Settings (RFC 0025)
		and Time (RFC 0028); Log keeps the log across restarts (RFC 0026),
		and Power powers the device off when the battery runs low.

if PNUT_SYSTEM

config PNUT_SYSTEM_STACKSIZE
	int "Its stack, in bytes"
	default 8192

config PNUT_PROGRAMS_PATH
	string "The programs' table"
	default "/etc/pnut/programs"
	---help---
		Which services each program runs (RFC 0007): Settings lets a
		program reach only its own services' settings.

config PNUT_STATES_SERVICES
	int "NxInit's services, at most"
	default 24
	range 1 255
	---help---
		Service states keeps each one's name, state and task: about 40
		bytes each.

config PNUT_BOARD_DESCRIPTION
	string "The device's description"
	default "/etc/pnut/board.pb"
	---help---
		Board (RFC 0024) serves it: the build compiles it from
		configs/<target>/board.toml.  Empty, or no file: Board serves
		none.

config PNUT_LOG_SOURCE
	string "The RAM log"
	default "/dev/kmsg"
	---help---
		Log (RFC 0026) follows it, and keeps its warnings and errors in
		files.  Empty, or a device without one: Log keeps nothing.

config PNUT_LOG_DIR
	string "Where Log's files are"
	default "/tmp/log"
	---help---
		system.log, the files it rotates into, and crash reports:
		/var/lib/log on a device with a file system in flash there
		(RFC 0010).  In /tmp they are lost at a restart.

config PNUT_LOG_FILE_SIZE
	int "A file's bytes, at most"
	default 65536
	range 512 16777216

config PNUT_LOG_FILES
	int "Files: system.log and those it rotates into"
	default 4
	range 1 9

config PNUT_LOG_CRASHES
	int "Crash reports kept"
	default 5
	range 1 99

config PNUT_LOG_CRASH_SIZE
	int "A crash report's bytes, at most"
	default 16384
	range 1024 1048576
	---help---
		A report is the RAM log up to the end of the crash's dump: its
		last lines, the dump among them, up to this many bytes.  The
		reports take the number kept times this of Log's directory.

config PNUT_LOG_DELAY
	int "From a line to its write, in milliseconds"
	default 5000
	range 10 3600000

config PNUT_LOG_BATCH
	int "Bytes waiting that are written at once"
	default 8192
	range 256 1048576
	---help---
		Log takes four times this from the heap while it runs: what waits,
		room for more while it is written, and the same again for the
		write.  As it starts, and for a crash's dump while it runs, it
		takes a copy of the whole RAM log too, until the crash report is
		written.

config PNUT_SETTINGS_DIR
	string "Where the settings' files are"
	default "/tmp/settings"
	---help---
		One file for each owner: /var/lib/settings on a device with a
		file system in flash there (RFC 0010).  In /tmp, settings are
		lost at a restart.

config PNUT_SETTINGS_DEFAULTS
	string "The target's defaults"
	default "/etc/pnut/defaults.pb"
	---help---
		The settings' defaults for this target, overriding their schemas'
		(RFC 0025): the build writes it from configs/<target>/defaults.toml.
		Empty for none.

config PNUT_SETTINGS_OWNERS
	int "Owners of settings"
	default 16
	range 1 255
	---help---
		Every module of a program whose loop has levels on holds an
		owner, if only for its log level (RFC 0026): six in the system
		program.  An owner that finds no room is refused, and its
		program tries again, logging only at debug.

config PNUT_SETTINGS_MAX
	int "Settings, all owners' together"
	default 256
	range 1 65535
	---help---
		About 240 bytes each, with its key, label, group, unit, range and
		value.

config PNUT_SETTINGS_TEXTS
	int "Strings, values and defaults together"
	default 64
	range 2 65535
	---help---
		About 270 bytes each; a string setting takes two, its value and
		its default.

config PNUT_SETTINGS_CHOICES
	int "Choices' names, all settings' together"
	default 128
	range 1 65535
	---help---
		About 40 bytes each.

config PNUT_SETTINGS_DELAY
	int "From a change to its write, in milliseconds"
	default 1000
	range 1 60000
	---help---
		A burst of changes makes one write (RFC 0025).

config PNUT_POWER_GAUGE
	string "The battery's fuel gauge"
	default "/dev/batt0"
	---help---
		Power reads the battery's voltage from it.  Without it, the device
		is taken to have no battery.

config PNUT_POWER_CHARGER
	string "The battery's charger"
	default "/dev/charger0"
	---help---
		Power learns from it whether there is external power; without it,
		from the gauge.

config PNUT_POWER_CUTOFF
	int "Power off at a battery voltage, in mV"
	default 3300
	range 0 5000
	depends on BOARDCTL_POWEROFF
	---help---
		On battery power, at or under this voltage the system program
		writes the settings and powers the device off (BOARDIOC_POWEROFF),
		before the cell runs down to its protection circuit.  0 never
		powers off; neither does a board without BOARDCTL_POWEROFF.

config PNUT_POWER_INTERVAL
	int "Between readings of the battery, in milliseconds"
	default 10000
	range 1000 600000
	depends on BOARDCTL_POWEROFF

config PNUT_POWER_READS
	int "Readings in a row at or under the cutoff"
	default 3
	range 1 255
	depends on BOARDCTL_POWEROFF
	---help---
		So that a dip under a burst of current, a radio sending, does not
		power the device off.

config PNUT_TIME_STATE
	string "Time's state file"
	default "/tmp/time"
	---help---
		Where Time keeps the clock's last good time and where it came from
		(RFC 0028), so that after a power loss the clock starts near it:
		on persistent storage, /var/lib/time.  Empty keeps none.

config PNUT_TIME_TOLERANCE
	int "How far a reading may be from the clock, in seconds"
	default 120
	range 1 86400
	---help---
		Once the clock has been set from a source, a reading further from
		it than this, plus the drift since the last reading allows, is
		held until a reading from another source agrees with it.

endif # PNUT_SYSTEM
```

## src/telephony/Kconfig
```kconfig
#
# For a description of the syntax of this configuration file,
# see the file kconfig-language.txt in the NuttX tools repository.
#
# SPDX-License-Identifier: Apache-2.0
#

config PNUT_TELEPHONY
	bool "The telephony program"
	default n
	depends on PNUT_LIB && NETUTILS_NANOPB && PNUT_SYSTEM
	---help---
		Telephony (RFC 0030): the cellular modem, powered, its UART
		multiplexed, its state and the network's time announced, the
		SIM's PIN taken.  The modem's UART and lines are Board's
		description's.  A device without a modem runs no telephony
		program.

if PNUT_TELEPHONY

config PNUT_TELEPHONY_STACKSIZE
	int "The program's stack, in bytes"
	default 8192

config PNUT_TELEPHONY_FINISH
	int "Time to power the modem down when asked to stop, in ms"
	default 9500
	---help---
		AT+CPOF, then up to 6 s or so for the modem to stop answering,
		2 s more, then its rail.  Keep it under
		CONFIG_SYSTEM_NXINIT_SERVICE_GENTLE_KILL_TIMEOUT, after which
		NxInit kills the program.

endif
```
