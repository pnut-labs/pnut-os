## src/commands/Kconfig
```kconfig
#
# For a description of the syntax of this configuration file,
# see the file kconfig-language.txt in the NuttX tools repository.
#
# SPDX-License-Identifier: Apache-2.0
#

config PNUT_COMMANDS
	bool "The shell's commands"
	default n
	depends on PNUT_LIB && NETUTILS_NANOPB
	---help---
		pnut-os's commands for NSH, for developers (RFC 0012): settings,
		to list, read, change and reset settings (RFC 0025); telephony,
		the modem's state, the SIM's PIN and an AT command passed
		through (RFC 0030); messages, the messages store's
		conversations, read, sent and deleted (RFC 0029).  A command
		typed in the developer's shell may do what the system UI may
		(PNUT_SETTINGS_SHELLS).

if PNUT_COMMANDS

config PNUT_COMMANDS_STACKSIZE
	int "A command's stack, in bytes"
	default 8192
	---help---
		Taken from the heap only while a command runs.  settings ran in
		4096 bytes on the T-Deck Max, unmeasured; this leaves room.

endif
```

## src/data/Kconfig
```kconfig
#
# For a description of the syntax of this configuration file,
# see the file kconfig-language.txt in the NuttX tools repository.
#
# SPDX-License-Identifier: Apache-2.0
#

config PNUT_DATA
	bool "The data program"
	default n
	depends on PNUT_LIB && NETUTILS_NANOPB && PNUT_SYSTEM
	---help---
		The data program (RFC 0007): Messages, the device's one store
		of text messages (RFC 0029), kept in files appended to in
		/var/lib/messages.  Contacts, Packages and Storage come later.

if PNUT_DATA

config PNUT_DATA_STACKSIZE
	int "The program's stack, in bytes"
	default 8192

config PNUT_DATA_WORKER_STACKSIZE
	int "A worker's stack, in bytes"
	default 6144
	---help---
		The workers read and write the store's files: littlefs, and
		nanopb's decoding of a record, deep under them.

config PNUT_MESSAGES_DIR
	string "Where the messages store's files are"
	default "/tmp/messages"
	---help---
		A log for each conversation, in segments: /var/lib/messages on
		a device with a file system in flash there (RFC 0010).  In
		/tmp, messages are lost at a restart.

config PNUT_MESSAGES_LIMIT
	int "The messages store's limit, in KB"
	default 1024
	range 64 65536
	---help---
		Past it, Messages deletes the oldest messages read or done
		with, a segment at a time; with none left that may go, it
		takes no more.  The device's fact, in Board's description once
		its schema has it (RFC 0029): the system partition also holds
		the settings, Time's state and the log.

endif
```

## src/lib/Kconfig
```kconfig
#
# For a description of the syntax of this configuration file,
# see the file kconfig-language.txt in the NuttX tools repository.
#
# SPDX-License-Identifier: Apache-2.0
#

config PNUT_LIB
	bool "libpnut, the service library"
	default n
	depends on !DISABLE_ALL_SIGNALS && !DISABLE_PTHREAD
	depends on NET_LOCAL_STREAM && NET_LOCAL_SCM && NET_SOCKOPTS
	select EVENT_FD
	select TIMER_FD
	select SIGNAL_FD
	---help---
		The code every pnut-os program shares (RFC 0023): an event loop on
		epoll, timers, workers, modules, fixed pools, logging, and
		services and clients on local stream sockets.

if PNUT_LIB

config PNUT_LIB_FDS
	int "Descriptors a loop watches at once"
	default 16

config PNUT_LIB_TIMERS
	int "Timers a loop runs at once"
	default 16
	---help---
		The program's own, and one for each service and each client open.
		A handler that closes one and opens another needs one more: the
		old one's is given back once the handler returns.

config PNUT_LIB_JOBS
	int "Jobs a loop queues at once"
	default 8

config PNUT_LIB_WORKERS
	int "Worker threads of a loop"
	default 1

config PNUT_LIB_WORKER_STACKSIZE
	int "A worker's stack, in bytes"
	default 4096

config PNUT_LIB_BUDGET
	int "A handler's budget, in milliseconds"
	default 10
	---help---
		A handler that runs longer is logged (RFC 0007).  Zero turns the
		check off.

config PNUT_LIB_LOG_LINE
	int "The longest log line, in characters"
	default 160

config PNUT_LIB_RUNDIR
	string "Where services' sockets are"
	default "/var/run"

config PNUT_LIB_CONNS
	int "Connections a service accepts at once"
	default 8
	range 1 255
	---help---
		Each takes a receive buffer of one message (4096 bytes) and a send
		buffer (PNUT_LIB_SENDBUF): 96 KB for 8 connections with the
		defaults.  A client takes as much for its own connection.

config PNUT_LIB_INFLIGHT
	int "Calls a client has in flight at once"
	default 8
	range 1 255
	---help---
		And the requests a service's connection may have waiting for
		their answers: one more is answered busy.

config PNUT_LIB_CALL_TIMEOUT
	int "A call's timeout, in milliseconds"
	default 5000

config PNUT_LIB_RECONNECT_MIN
	int "A client's first wait before reconnecting, in milliseconds"
	default 100

config PNUT_LIB_RECONNECT_MAX
	int "A client's longest wait before reconnecting, in milliseconds"
	default 5000

config PNUT_LIB_SENDBUF
	int "A connection's send buffer, in bytes"
	default 8192
	---help---
		At least one message (4096 bytes).  A local socket takes
		CONFIG_DEV_FIFO_SIZE bytes at a time; the rest waits here.  A
		service's connection takes a request only with room for its
		answer kept here, as large as its method says: with 8192 bytes,
		two requests of methods that say nothing (a whole message each)
		wait for their answers at most, and those after them in the
		socket.

endif # PNUT_LIB
```

## src/media/Kconfig
```kconfig
#
# For a description of the syntax of this configuration file,
# see the file kconfig-language.txt in the NuttX tools repository.
#
# SPDX-License-Identifier: Apache-2.0
#

config PNUT_MEDIA
	bool "The media program"
	default n
	depends on PNUT_LIB && NETUTILS_NANOPB && PNUT_SYSTEM
	---help---
		The media program (RFC 0007): so far Haptics (RFC 0033), which
		plays named effects and callers' own patterns on the vibration
		motor Board's description names.  Audio comes next.

if PNUT_MEDIA

config PNUT_MEDIA_STACKSIZE
	int "The program's stack, in bytes"
	default 6144

config PNUT_HAPTICS_DEVICE
	string "The motor's device, without Board"
	default ""
	---help---
		Empty: Haptics asks Board for the vibration motor
		(RFC 0024).  A path (a force-feedback device such as
		/dev/input_ff0) skips Board, for a target without its
		description.

config PNUT_AUDIO
	bool "Audio: the speaker (RFC 0032)"
	default y
	depends on AUDIO
	---help---
		The built-in sounds, mixed and played on the speaker
		Board's description names, by the uses' rules.

if PNUT_AUDIO

config PNUT_AUDIO_DEVICE
	string "The speaker's device, without Board"
	default ""
	---help---
		Empty: Audio asks Board for the speaker (RFC 0024).  A
		path (an audio device such as /dev/audio/pcm0) skips
		Board, for a target without its description.

config PNUT_AUDIO_SOUNDS
	string "The built-in sounds' directory"
	default "/usr/share/sounds"
	---help---
		Each <name>.wav in it is a built-in sound, read whole at
		start (RFC 0010; the system program mounts /usr).

config PNUT_AUDIO_HIGHPASS
	int "The speaker's high-pass, Hz (0: none)"
	default 300
	range 0 2000
	---help---
		What the speaker cannot play only shakes it, and is heard
		as distortion: taken out of everything played.

endif

endif
```

## src/network/Kconfig
```kconfig
#
# For a description of the syntax of this configuration file,
# see the file kconfig-language.txt in the NuttX tools repository.
#
# SPDX-License-Identifier: Apache-2.0
#

config PNUT_NETWORK
	bool "The network program"
	default n
	depends on PNUT_LIB && NETUTILS_NANOPB && PNUT_SYSTEM && WIRELESS_WAPI && NETUTILS_DHCPC && NETUTILS_NETLIB
	---help---
		The network program: Wi-Fi (RFC 0031), which scans, joins a
		network and takes an address, and says the link's state on the
		wifi topic; and Network (RFC 0015), so far the link in use, on
		the network topic, and its name server.

if PNUT_NETWORK

config PNUT_NETWORK_STACKSIZE
	int "The program's stack, in bytes"
	default 8192

config PNUT_NETWORK_WORKER_STACKSIZE
	int "A worker's stack, in bytes"
	default 6144
	---help---
		The worker makes the radio's calls: the driver's association
		and DHCP run on its stack, as they ran on the system before
		this one's 6 KB thread.

config PNUT_NETWORK_LOCAL_LINKS
	string "The local links"
	default "wlan0"
	---help---
		The interfaces of the networks the device is in, as Wi-Fi's or
		Ethernet's, never mobile data's, separated by spaces: the local
		ports reach the device on them only (RFC 0012).

config PNUT_NETWORK_LOCAL_PORTS
	string "TCP ports served on the local links only"
	default ""
	---help---
		Besides adb's (ADBD_TCP_SERVER_PORT), always one, separated by
		spaces: connections to them from any other link, as mobile
		data, are dropped.  Through NuttX's packet filter
		(NET_IPFILTER): without it, Network says so in the log, and the
		ports are open on every link.

config PNUT_WIFI_IFNAME
	string "The Wi-Fi interface"
	default "wlan0"

config PNUT_WIFI_ENABLE
	string "The board's device that brings the Wi-Fi driver up"
	default ""
	---help---
		A GPIO device written 1 once, as the T-Deck Max's /dev/wifi_en,
		where the board leaves the driver down until asked; empty where
		the driver is up from the start.

endif
```

## src/radios/Kconfig
```kconfig
#
# For a description of the syntax of this configuration file,
# see the file kconfig-language.txt in the NuttX tools repository.
#
# SPDX-License-Identifier: Apache-2.0
#

config PNUT_RADIOS
	bool "The radios program"
	default n
	depends on PNUT_LIB && NETUTILS_NANOPB && PNUT_SYSTEM && LPWAN_SX126X
	---help---
		The radios program (RFC 0007): so far Radio (RFC 0034), which
		gives one caller at a time the LoRa radio Board's description
		names, set up as it asks, and checks every send against the
		region's band plan.  Bluetooth and NFC come later.

if PNUT_RADIOS

config PNUT_RADIOS_STACKSIZE
	int "The program's stack, in bytes"
	default 6144

config PNUT_RADIOS_WORKER_STACKSIZE
	int "A worker's stack, in bytes"
	default 4096
	---help---
		The worker sends Radio's packets: a write() to the driver,
		which waits until the packet is on the air.

endif
```

## src/sensors/Kconfig
```kconfig
#
# For a description of the syntax of this configuration file,
# see the file kconfig-language.txt in the NuttX tools repository.
#
# SPDX-License-Identifier: Apache-2.0
#

config PNUT_SENSORS
	bool "The sensors program"
	default n
	depends on PNUT_LIB && NETUTILS_NANOPB && PNUT_SYSTEM && SENSORS_GNSS
	---help---
		The sensors program (RFC 0007): so far Location (RFC 0035),
		which answers where the device is from the GNSS receiver
		Board's description names, switched on only while asked, and
		Motion (RFC 0036).  Sensors comes later.

if PNUT_SENSORS

config PNUT_SENSORS_STACKSIZE
	int "The program's stack, in bytes"
	default 6144

config PNUT_SENSORS_WORKER_STACKSIZE
	int "A worker's stack, in bytes"
	default 4096
	---help---
		The worker reads and writes Location's saved state and
		Motion's steps, and opens the motion sensors (the first
		uploads the hub's firmware).

config PNUT_LOCATION_DIR
	string "Location's saved state"
	default "/var/lib/location"
	---help---
		The last fix and the receiver's orbit data, kept across its
		switch-offs (RFC 0035, RFC 0010).

config PNUT_LOCATION_LINGER
	int "The receiver kept on after the last caller, ms"
	default 5000

config PNUT_MOTION
	bool "Motion"
	default y
	depends on SENSORS_BHI260AP
	---help---
		Motion (RFC 0036): still or moving, facing, today's steps,
		activity and the wake gestures, from the BHI260AP sensor hub's
		virtual sensors.

if PNUT_MOTION

config PNUT_MOTION_DIR
	string "Today's steps, kept"
	default "/var/lib/motion"

config PNUT_MOTION_SAVE
	int "Between saves of a changed step count, ms"
	default 600000
	---help---
		A restart loses no steps (they are saved as Motion stops); a
		power loss loses those since the last save.

endif

endif
```
